/*
 * Copyright (c) 2023 The ZMK Contributors
 *
 * SPDX-License-Identifier: MIT
 */

 #include <dt-bindings/zmk/behaviors.h>

/ {
	behaviors {
#if ZMK_BEHAVIOR_OMIT(MWH)
        /omit-if-no-ref/
#endif
		mwh: msc: behavior_mouse_scroll {
			compatible = "zmk,behavior-mouse-scroll";
			#binding-cells = <1>;
			delay-ms = <0>;
			time-to-max-speed-ms = <300>;
			acceleration-exponent = <0>;
		};
	};
};